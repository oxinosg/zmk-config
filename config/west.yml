## config/west.yml
```yaml
# This file specifies the build dependencies for Github Action workflows and
# for local build environments. The workspace has four toplevel directories
# containing the user config, modules, zephy and ZMK.
#
# ZMK-Workspace
# ├── config
# ├── modules
# ├── zephyr
# └── zmk
#
# To create a local build environment, clone this repository and then run the
# following commands from its toplevel directory:
#
# $ west init -l config
# $ west update
# $ west zephyr-export
#
---
manifest:
  defaults:
    remote: urob
    revision: v0.2 # Pin everything to v0.2

  remotes:
    - name: urob
      url-base: https://github.com/urob
    - name: caksoylar
      url-base: https://github.com/caksoylar
    - name: zmkfirmware
      url-base: https://github.com/zmkfirmware
    - name: duckyb
      url-base: https://github.com/duckyb
      # nice-view-gem
    - name: m165437
      url-base: https://github.com/M165437
      # nice-view-adventure-time
    # - name: whoop-t
    #   url-base: https://github.com/whoop-t
      # nice-view-adventure-time with layer status
    - name: oxinosg
      url-base: https://github.com/oxinosg


  projects:
    - name: zmk
      remote: zmkfirmware
      import: app/west.yml

    - name: urchin-zmk-module
      remote: duckyb
      revision: main
    # - name: nice-view-gem
  #   remote: m165437
    #   revision: main
    # - name: nice-adventure-time
    #   remote: whoop-t
    #   revision: main
    - name: nice-adventure-time
      remote: oxinosg
      revision: main

    # ZMK modules
    - name: zmk-adaptive-key
      path: modules/zmk/adaptive-key
    - name: zmk-auto-layer
      path: modules/zmk/auto-layer
    - name: zmk-helpers
      path: modules/zmk/helpers
    - name: zmk-tri-state
      path: modules/zmk/tri-state

    # Temporarily overload Zephyr until
    # https://github.com/zmkfirmware/zephyr/pull/40 is merged.
    - name: zephyr
      revision: v3.5.0+zmk-fixes
      clone-depth: 1
      import:
        # Only enable most commonly used boards. For less common hardware one
        # may need to enable additional modules.
        name-allowlist:
          - cmsis
          - hal_nordic
          - hal_rpi_pico
          - hal_stm32
          - lvgl
          - tinycrypt

  self:
    path: config
```
